// Glance for GeekMagic SmallTV Ultra (ESP8266) - Crypto / Stock / FX ticker on a 240x240 ST7789.
// Three auto-cycling pages (코인/주식/달러시장) + header clock + weather footer,
// a web settings page, and a night dim / big-clock mode. See README.md.
//
// Data sources (all free, no API key):
//   - Crypto/stablecoins: api.bithumb.com (BTC, ETH, KAIA, USDT, USDC - KRW spot)
//   - Stocks/index/fx:    query1.finance.yahoo.com (KOSPI, Samsung, SK Hynix, USD/KRW)
//   - Weather:            api.open-meteo.com (temperature + weather code)

// Platform layer: the SmallTV Ultra is ESP8266, the SmallTV Pro is ESP32. The
// two cores ship the same WiFi/HTTP/WebServer/OTA classes under different names
// and headers, so alias them here and the rest of the file stays platform-clean.
#if defined(ESP32)
  #include <WiFi.h>
  #include <WiFiClientSecure.h>
  #include <HTTPClient.h>
  #include <WebServer.h>
  #include <HTTPUpdateServer.h>
  using WebServerClass        = WebServer;
  using HTTPUpdateServerClass = HTTPUpdateServer;
#else
  #include <ESP8266WiFi.h>
  #include <WiFiClientSecure.h>
  #include <ESP8266HTTPClient.h>
  #include <ESP8266WebServer.h>
  #include <ESP8266HTTPUpdateServer.h>
  using WebServerClass        = ESP8266WebServer;
  using HTTPUpdateServerClass = ESP8266HTTPUpdateServer;
#endif
#include <WiFiManager.h>
#include <EEPROM.h>
#include <ArduinoJson.h>
#include <TFT_eSPI.h>
#include <time.h>
#include "kr_labels.h"    // generated by tools/gen_kr_labels.py
#include "coin_logos.h"   // generated by tools/gen_coin_logos.py
#include "title_logo.h"   // generated by tools/gen_title.py (TITLE_GLANCE)
#include "smooth_font.h"  // generated by tools/gen_smooth_font.py (PRICE_FONT)
#include "smooth_clock.h" // generated by tools/gen_clock_font.py (CLOCK_FONT)
#include "smooth_footer.h" // generated by tools/gen_footer_font.py (FOOTER_FONT)

// ----------------------------- USER CONFIG -----------------------------
// WiFi is NOT hardcoded. On first boot (or if it can't connect) the device
// opens a setup hotspot named AP_NAME; connect with your phone and pick your
// WiFi. Firmware can be re-flashed over the air at http://<device-ip>/update.
const char* AP_NAME     = "SmallTV-Setup";  // setup hotspot SSID (open network)
const char* OTA_USER    = "admin";          // login for the /update page
const char* OTA_PASS    = "smalltv";         // change this
const uint16_t PORTAL_TIMEOUT_S = 180;      // give up the setup portal after 3 min

const uint8_t  ROTATION      = 0;          // 0..3 - change if screen is upside down
const bool     INVERT_COLORS = true;       // most 1.54" IPS ST7789 panels need this

// Footer: date / weekday / time (NTP) + current temperature (Open-Meteo, no key).
const float    LAT      = 37.5665;   // your location (default: Seoul)
const float    LON      = 126.9780;
const int32_t  TZ_OFFSET_SEC = 9 * 3600;   // KST = UTC+9 (Korea has no DST)
const uint32_t PIMON_INTERVAL_MS = 3000;   // Pi monitor refresh (local agent, so fast)

// Touch button - GeekMagic Pro (ESP32) only: one capacitive pad on GPIO32.
// Gestures: short tap / double tap / long press. See loop() for the mapping.
#if defined(ESP32)
const uint8_t  TOUCH_GPIO      = 32;
const float    TOUCH_TRIG      = 0.10f;   // drop from baseline to ENGAGE a press (~light finger)
const float    TOUCH_REL       = 0.04f;   // must recover to within this to RELEASE (hysteresis vs chatter)
const uint32_t LONGPRESS_MS    = 700;     // hold this long -> long press
const uint32_t DOUBLETAP_MS    = 300;     // 2nd tap within this -> double tap
const uint32_t MENU_TIMEOUT_MS = 30000;   // auto-close the mode menu after 30s inactivity
int            touchBaseline   = 0;       // idle touchRead level, calibrated at boot
#endif
// ------------------------------------------------------------------------

// Runtime settings, edited via the web page and persisted in EEPROM.
#define CFG_MAGIC 0x53545635  // bump to invalidate old layouts
struct Config {
  uint32_t magic;
  uint8_t  brightness;   // day backlight 0..255
  uint8_t  nightBright;  // night backlight 0..255
  uint8_t  nightStart;   // night begins at this hour (0..23)
  uint8_t  nightEnd;     // night ends at this hour (0..23)
  bool     nightDim;     // dim the screen during the night window
  bool     nightClock;   // show a big clock (instead of tickers) during the night window
  uint16_t pageSec;      // page auto-swap interval (s)
  uint16_t fetchSec;     // data refresh interval (s)
  uint8_t  mode;         // 0 = market ticker, 1 = Pi monitor
  char     piHost[24];   // Raspberry Pi agent host/IP
  uint16_t piPort;       // Pi agent port
};
Config cfg;

void cfgDefaults() {
  cfg.magic       = CFG_MAGIC;
  cfg.brightness  = 100;
  cfg.nightBright = 15;
  cfg.nightStart  = 1;
  cfg.nightEnd    = 7;
  cfg.nightDim    = true;
  cfg.nightClock  = true;
  cfg.pageSec     = 6;
  cfg.fetchSec    = 60;
  cfg.mode        = 0;
  cfg.piHost[0]   = '\0';
  cfg.piPort      = 8080;
}
void cfgLoad() {
  EEPROM.begin(512);
  EEPROM.get(0, cfg);
  if (cfg.magic != CFG_MAGIC) { cfgDefaults(); EEPROM.put(0, cfg); EEPROM.commit(); }
}
void cfgSave() { EEPROM.put(0, cfg); EEPROM.commit(); }

TFT_eSPI tft = TFT_eSPI();
WebServerClass        httpServer(80);
HTTPUpdateServerClass httpUpdater;

#define SPARK_N 16   // max sparkline points stored per ticker
#define RGB565(r, g, b) ((uint16_t)((((r) & 0xF8) << 8) | (((g) & 0xFC) << 3) | ((b) >> 3)))

struct Ticker {
  const char*    label;   // ASCII fallback / crypto ticker
  float          price;
  float          changePct;
  bool           valid;
  uint8_t        decimals;
  const KRLabel*  kr;     // optional Korean bitmap label (nullptr = use `label`)
  const CoinLogo* logo;   // optional full-color coin logo before the ticker (nullptr = none)
  float          spark[SPARK_N];  // recent price series for the sparkline
  uint8_t        sparkN;          // 0 = no sparkline
};

// Three pages, 3 rows each. Data sources are assigned explicitly in fetchAll().
#define NUM_PAGES 4
#define ROWS_PER_PAGE 3

// UI modes selectable via the web page and (on the Pro) the touch mode-menu.
#define NUM_MODES 3
const char* MODE_NAMES[NUM_MODES] = {"Market", "Pi Monitor", "Clock"};

// 코인시장 - Bithumb spot
Ticker coins[3] = {
  {"BTC",  0, 0, false, 0, nullptr, &LOGO_BTC},   // KRW: ~96,000,000
  {"ETH",  0, 0, false, 0, nullptr, &LOGO_ETH},   // KRW: ~2,700,000
  {"KAIA", 0, 0, false, 2, nullptr, &LOGO_KAIA},  // KRW: ~54
};

// 주식시장 - Yahoo Finance (^KS11 is URL-encoded as %5EKS11)
Ticker stocks[3] = {
  {"KOSPI",    0, 0, false, 2, &KR_KOSPI},
  {"Samsung",  0, 0, false, 0, &KR_SS},
  {"SK Hynix", 0, 0, false, 0, &KR_HYNIX},
};

// 주식시장 page 2 - KODEX inverse / 2x inverse / leverage ETFs (Yahoo)
Ticker stocks2[3] = {
  {"Inverse",  0, 0, false, 0, &KR_INV},
  {"Inverse2X",0, 0, false, 0, &KR_INV2},
  {"Leverage", 0, 0, false, 0, &KR_LEV},
};

// 달러시장 - USD/KRW from Yahoo, USDT/USDC from CoinGecko (USD-pegged)
Ticker dollar[3] = {
  {"USD/KRW", 0, 0, false, 2, &KR_USDKRW},
  {"USDT",    0, 0, false, 2, nullptr},
  {"USDC",    0, 0, false, 2, nullptr},
};

Ticker*        pageItems[NUM_PAGES] = {coins, dollar, stocks, stocks2};
const KRLabel* pageTitle[NUM_PAGES] = {&KR_TITLE_CRYPTO, &KR_TITLE_DOLLAR, &KR_TITLE_STOCK, &KR_TITLE_STOCK};

uint32_t lastFetch = 0;
uint32_t lastPage  = 0;
uint8_t  page      = 0;  // 0 = CRYPTO, 1 = KOREA

float    g_tempC   = 0;
int      g_wxCode  = -1;      // Open-Meteo WMO weather code
bool     g_tempValid = false;
int      lastSec = -1;        // redraw header clock only when the second changes
uint32_t g_displayStartMs = 0;  // when the UI first appeared (after the slow first fetch)
int      appliedBright = -1;  // last brightness value written to the backlight
bool     clockMode = false;   // night big-clock mode active
bool     autoClock = false;   // night auto-clock is currently overlaying the selected mode
bool     prevNight = false;   // edge-detect the start of the night window
int      lastClockMin = -1;   // redraw the big clock only when the minute changes
bool     forceFullRedraw = false;  // clear stale pixels after switching UI modes
bool     inMenu     = false;  // mode-select menu is showing (Pro touch only; always false on Ultra)
uint8_t  menuSel    = 0;      // highlighted mode in that menu (0..NUM_MODES-1)
uint32_t menuOpenedMs = 0;    // for the menu inactivity timeout

// diagnostics (surfaced on the web status page)
int      g_lastHttpCode = 0;  // last HTTP/HTTPClient result from httpGetStream
int      g_dbgCrypto = 0;     // CoinGecko: 200 ok, -2 parse err, else HTTP/conn code
int      g_dbgWx     = 0;     // Open-Meteo status

// ---- colors ----
#define COL_BG    TFT_BLACK
#define COL_TEXT  0xEF7D  // warm off-white
#define COL_DIM   0x8C92  // muted grey-blue
// Korean market convention: up = red, down = blue.
uint16_t colUp()    { return tft.color565(240, 65, 55); }    // red
uint16_t colDown()  { return tft.color565(70, 140, 255); }   // blue
uint16_t colLabel() { return tft.color565(140, 148, 164); }  // dimmed label grey
uint16_t colSep()   { return tft.color565(16, 18, 24); }     // subtle row separator
uint16_t colTrack() { return tft.color565(10, 12, 16); }

// Insert thousands separators, e.g. 65000.5 -> "65,000.50"
String withCommas(double v, uint8_t dec) {
  char buf[32];
  dtostrf(v, 0, dec, buf);
  String s(buf);
  int dot    = s.indexOf('.');
  int intEnd = (dot == -1) ? s.length() : dot;
  int start  = (s.length() > 0 && s[0] == '-') ? 1 : 0;
  String res;
  for (int i = 0; i < (int)s.length(); i++) {
    if (i > start && i < intEnd && ((intEnd - i) % 3 == 0)) res += ',';
    res += s[i];
  }
  return res;
}

// ---------------------------- data fetching ----------------------------
bool httpGetStream(const char* url, WiFiClientSecure& client, HTTPClient& https,
                   bool yahooHeaders) {
  client.setInsecure();  // skip cert validation (no root CA store on ESP8266)
  // NOTE: don't shrink the RX buffer here. CoinGecko/Yahoo sit behind CDNs that
  // usually don't support TLS max-fragment-length, so a small buffer breaks the
  // handshake. The default 16KB buffer is what makes HTTPS reliable on ESP8266.
  if (!https.begin(client, url)) { g_lastHttpCode = -999; return false; }
  // A descriptive User-Agent is REQUIRED: CoinGecko returns 403 without one.
  https.addHeader("User-Agent", "Glance/1.0 (ESP8266)");
  if (yahooHeaders) https.addHeader("Accept", "application/json");
  int code = https.GET();
  g_lastHttpCode = code;
  if (code != HTTP_CODE_OK) {
    Serial.printf("GET %s -> %d\n", url, code);
    https.end();
    return false;
  }
  return true;
}

// Bithumb spot price (Korean exchange, KRW = kimchi-premium-inclusive).
// closing_price = last trade, fluctate_rate_24H = 24h change %. Both are JSON strings.
void fetchBithumbOne(const char* sym, Ticker& t) {
  WiFiClientSecure client;
  HTTPClient https;
  String url = String("https://api.bithumb.com/public/ticker/") + sym + "_KRW";
  if (!httpGetStream(url.c_str(), client, https, false)) return;

  String payload = https.getString();  // getString() de-chunks
  https.end();
  JsonDocument doc;
  if (deserializeJson(doc, payload)) return;
  if (strcmp(doc["status"] | "", "0000") != 0) return;  // Bithumb OK status
  JsonObject d = doc["data"];
  if (d.isNull()) return;
  float price = atof(d["closing_price"]     | "0");
  float rate  = atof(d["fluctate_rate_24H"] | "0");
  if (price <= 0) return;
  t.price     = price;
  t.changePct = rate;
  t.valid     = true;
}


// One Yahoo Finance chart symbol -> one Ticker. sym is URL-encoded (^KS11 = %5EKS11).
// withSpark=true also captures the intraday close series into t.spark for a sparkline.
void fetchYahooOne(const char* sym, Ticker& t, bool withSpark = false) {
  WiFiClientSecure client;
  HTTPClient https;
  String url = String("https://query1.finance.yahoo.com/v8/finance/chart/") +
               sym + "?range=1d&interval=30m";
  if (!httpGetStream(url.c_str(), client, https, true)) return;

  // Filter down to the fields we need (meta + optionally the close series).
  JsonDocument filter;
  filter["chart"]["result"][0]["meta"]["regularMarketPrice"] = true;
  filter["chart"]["result"][0]["meta"]["chartPreviousClose"] = true;
  if (withSpark)
    filter["chart"]["result"][0]["indicators"]["quote"][0]["close"] = true;

  JsonDocument doc;
  DeserializationError err =
      deserializeJson(doc, https.getStream(), DeserializationOption::Filter(filter));
  https.end();
  if (err) { Serial.printf("yahoo json: %s\n", err.c_str()); return; }

  JsonObject meta = doc["chart"]["result"][0]["meta"];
  if (meta.isNull()) return;
  float p  = meta["regularMarketPrice"] | 0.0f;
  float pc = meta["chartPreviousClose"] | 0.0f;
  if (p <= 0 || pc <= 0) return;
  t.price     = p;
  t.changePct = (p - pc) / pc * 100.0f;
  t.valid     = true;

  if (withSpark) {
    JsonArray cl = doc["chart"]["result"][0]["indicators"]["quote"][0]["close"];
    float tmp[64];
    int tn = 0;
    for (JsonVariant v : cl)
      if (!v.isNull() && tn < 64) tmp[tn++] = v.as<float>();
    int start = (tn > SPARK_N) ? tn - SPARK_N : 0;  // keep the most recent points
    t.sparkN = 0;
    for (int i = start; i < tn; i++) t.spark[t.sparkN++] = tmp[i];
  }
}

void fetchWeather() {
  WiFiClientSecure client;
  HTTPClient https;
  String url = String("https://api.open-meteo.com/v1/forecast?latitude=") +
               String(LAT, 4) + "&longitude=" + String(LON, 4) +
               "&current=temperature_2m,weather_code";
  if (!httpGetStream(url.c_str(), client, https, false)) { g_dbgWx = g_lastHttpCode; return; }

  String payload = https.getString();  // getString() de-chunks; raw stream does not
  https.end();
  JsonDocument doc;
  DeserializationError err = deserializeJson(doc, payload);
  if (err) { g_dbgWx = -(200 + (int)err.code()); Serial.printf("weather json: %s\n", err.c_str()); return; }

  JsonVariant t = doc["current"]["temperature_2m"];
  if (t.isNull()) { g_dbgWx = -3; return; }
  g_tempC     = t.as<float>();
  g_wxCode    = doc["current"]["weather_code"] | -1;
  g_tempValid = true;
  g_dbgWx     = 200;
}

// ---- Pi monitor ----
struct PiStats {
  bool  valid;
  char  host[24];
  float cpu, memUsed, memTotal, diskUsed, diskTotal, temp;
};
PiStats g_pi = {false, "", 0, 0, 0, 0, 0, 0};

void fetchPiStats() {
  if (cfg.piHost[0] == '\0') { g_pi.valid = false; return; }
  WiFiClient client;                 // plain HTTP to the Pi agent (no TLS)
  HTTPClient http;
  String url = String("http://") + cfg.piHost + ":" + cfg.piPort + "/";
  if (!http.begin(client, url)) { g_pi.valid = false; return; }
  http.addHeader("User-Agent", "Glance/1.0");
  int code = http.GET();
  if (code != HTTP_CODE_OK) { http.end(); g_pi.valid = false; return; }
  String payload = http.getString();
  http.end();
  JsonDocument doc;
  if (deserializeJson(doc, payload)) { g_pi.valid = false; return; }
  strlcpy(g_pi.host, doc["host"] | "pi", sizeof(g_pi.host));
  g_pi.cpu       = doc["cpu"]        | 0.0f;
  g_pi.memUsed   = doc["mem_used"]   | 0.0f;
  g_pi.memTotal  = doc["mem_total"]  | 0.0f;
  g_pi.diskUsed  = doc["disk_used"]  | 0.0f;
  g_pi.diskTotal = doc["disk_total"] | 0.0f;
  g_pi.temp      = doc["temp"]       | 0.0f;
  g_pi.valid     = true;
}

void fetchAll() {
  Serial.println("Fetching...");
  fetchBithumbOne("BTC",  coins[0]);      // 코인시장 (Bithumb spot)
  fetchBithumbOne("ETH",  coins[1]);
  fetchBithumbOne("KAIA", coins[2]);
  fetchYahooOne("%5EKS11",   stocks[0], true);  // 주식시장 (Yahoo) + sparkline
  fetchYahooOne("005930.KS", stocks[1], true);
  fetchYahooOne("000660.KS", stocks[2], true);
  fetchYahooOne("114800.KS", stocks2[0], true); // 주식시장 2: KODEX 인버스
  fetchYahooOne("252670.KS", stocks2[1], true); // KODEX 200선물인버스2X
  fetchYahooOne("122630.KS", stocks2[2], true); // KODEX 레버리지
  fetchYahooOne("KRW=X",     dollar[0]);         // 달러시장: USD/KRW (no sparkline)
  fetchBithumbOne("USDT",    dollar[1]);  // USDT (Bithumb, 김프 반영)
  fetchBithumbOne("USDC",    dollar[2]);  // USDC (Bithumb, 김프 반영)
  fetchWeather();
  Serial.println("Done.");
}

// ------------------------------ rendering ------------------------------
// Draw a 1-bpp Korean label bitmap (MSB-first, row-padded to bytes) from PROGMEM.
void drawKRLabel(int x, int y, const KRLabel& L, uint16_t color) {
  uint16_t byteW = (L.w + 7) / 8;
  for (uint16_t j = 0; j < L.h; j++) {
    int runStart = -1;
    for (uint16_t i = 0; i <= L.w; i++) {
      bool on = i < L.w &&
          (pgm_read_byte(&L.data[j * byteW + i / 8]) & (0x80 >> (i & 7)));
      if (on && runStart < 0) runStart = i;
      if (!on && runStart >= 0) {
        tft.drawFastHLine(x + runStart, y + j, i - runStart, color);
        runStart = -1;
      }
    }
  }
}

// Blit a full-color RGB565 logo in one windowed transfer.
void drawLogo(int x, int y, const CoinLogo* L) {
  bool oldSwap = tft.getSwapBytes();
  tft.setSwapBytes(true);
  tft.pushImage(x, y, L->w, L->h, L->data);
  tft.setSwapBytes(oldSwap);
}

// Mini line chart of pts[0..n) inside the box (x0,y0,w,h), auto-scaled.
void drawSparkline(int x0, int y0, int w, int h, const float* pts, int n, uint16_t c) {
  if (n < 2) return;
  float mn = pts[0], mx = pts[0];
  for (int i = 1; i < n; i++) { if (pts[i] < mn) mn = pts[i]; if (pts[i] > mx) mx = pts[i]; }
  float range = mx - mn;
  if (range <= 0) range = 1;
  int pxPrev = 0, pyPrev = 0;
  for (int i = 0; i < n; i++) {
    int px = x0 + (w * i) / (n - 1);
    int py = y0 + h - (int)((pts[i] - mn) / range * h);
    if (i > 0) tft.drawLine(pxPrev, pyPrev, px, py, c);
    pxPrev = px; pyPrev = py;
  }
}

void drawRow(int y, const Ticker& t) {
  uint16_t chColor = (t.changePct >= 0) ? colUp() : colDown();

  int lx = 8;
  if (t.logo) {
    drawLogo(lx, y + 3, t.logo);
    lx += t.logo->w + 6;
  }
  if (t.kr) {
    drawKRLabel(lx, y + 2, *t.kr, colLabel());
  } else {
    tft.setTextDatum(TL_DATUM);
    tft.setTextColor(colLabel(), COL_BG);
    tft.drawString(t.label, lx, y + 1, 4);
  }

  if (!t.valid) {
    tft.setTextDatum(TR_DATUM);
    tft.setTextColor(COL_DIM, COL_BG);
    tft.drawString("--", 232, y + 2, 4);
    return;
  }

  tft.loadFont(PRICE_FONT);
  tft.setTextDatum(TR_DATUM);
  tft.setTextColor(COL_TEXT, COL_BG);
  tft.drawString(withCommas(t.price, t.decimals), 232, y - 8);
  tft.unloadFont();

  char pct[16];
  snprintf(pct, sizeof(pct), "%.2f%%", fabs(t.changePct));
  tft.setTextDatum(TR_DATUM);
  tft.setTextColor(chColor, COL_BG);
  tft.drawString(pct, 232, y + 22, 2);
  int pw = tft.textWidth(pct, 2);
  int tr = 232 - pw - 5, tl = tr - 7;
  int yt = y + 25, yb = y + 34;
  bool up = t.changePct >= 0;
  if (up) tft.fillTriangle(tl, yb, tr, yb, (tl + tr) / 2, yt, chColor);
  else    tft.fillTriangle(tl, yt, tr, yt, (tl + tr) / 2, yb, chColor);

  if (t.sparkN >= 2) drawSparkline(8, y + 29, 140, 9, t.spark, t.sparkN, chColor);
}

void drawCloudShape(int cx, int cy, uint16_t c) {
  tft.fillCircle(cx - 5, cy + 2, 4, c);
  tft.fillCircle(cx + 1, cy,     5, c);
  tft.fillCircle(cx + 6, cy + 2, 4, c);
  tft.fillRect(cx - 5, cy + 2, 12, 5, c);
}

// Emoji-style weather icon (~22x20) mapped from an Open-Meteo WMO code.
void drawWeatherIcon(int x, int y, int code) {
  const uint16_t SUN   = tft.color565(255, 200, 0);
  const uint16_t CLOUD = tft.color565(205, 210, 222);
  const uint16_t RAIN  = tft.color565(70, 140, 255);
  const uint16_t UMB   = tft.color565(235, 70, 70);
  const uint16_t BOLT  = tft.color565(255, 210, 0);
  int cx = x + 10, cy = y + 9;

  int cat;  // 0 sun, 1 cloud, 2 rain(umbrella), 3 snow, 4 storm, 5 fog
  if (code <= 1) cat = 0;
  else if (code == 2 || code == 3) cat = 1;
  else if (code == 45 || code == 48) cat = 5;
  else if ((code >= 51 && code <= 67) || (code >= 80 && code <= 82)) cat = 2;
  else if ((code >= 71 && code <= 77) || code == 85 || code == 86) cat = 3;
  else if (code >= 95) cat = 4;
  else cat = 1;

  switch (cat) {
    case 0:  // sun
      tft.fillCircle(cx, cy, 5, SUN);
      for (int a = 0; a < 360; a += 45) {
        float r = a * 0.01745329;
        tft.drawLine(cx + cos(r) * 7, cy + sin(r) * 7,
                     cx + cos(r) * 10, cy + sin(r) * 10, SUN);
      }
      break;
    case 1:  // cloud
      drawCloudShape(cx, cy, CLOUD);
      break;
    case 2:  // rain -> umbrella
      tft.fillCircle(cx, cy - 1, 8, UMB);
      tft.fillRect(cx - 9, cy, 19, 10, COL_BG);  // keep only the dome
      tft.drawFastVLine(cx, cy - 1, 9, CLOUD);   // shaft
      tft.drawLine(cx, cy + 8, cx - 2, cy + 7, CLOUD);
      tft.fillCircle(cx + 6, cy + 7, 1, RAIN);   // a raindrop
      break;
    case 3:  // snow
      for (int a = 0; a < 180; a += 60) {
        float r = a * 0.01745329;
        tft.drawLine(cx - cos(r) * 7, cy - sin(r) * 7,
                     cx + cos(r) * 7, cy + sin(r) * 7, TFT_WHITE);
      }
      tft.fillCircle(cx, cy, 1, TFT_WHITE);
      break;
    case 4:  // thunderstorm
      drawCloudShape(cx, cy - 1, CLOUD);
      tft.drawLine(cx + 1, cy + 3, cx - 2, cy + 8, BOLT);
      tft.drawLine(cx - 2, cy + 8, cx + 1, cy + 8, BOLT);
      tft.drawLine(cx + 1, cy + 8, cx - 1, cy + 12, BOLT);
      break;
    default:  // fog
      for (int i = 0; i < 3; i++) tft.drawFastHLine(cx - 8, cy - 3 + i * 4, 17, CLOUD);
      break;
  }
}

// Bottom status area: date, current time, and weather.

void drawFooter() {
  tft.fillRect(0, 210, 240, 30, COL_BG);

  time_t now = time(nullptr);
  bool synced = now > 100000;
  struct tm tm;
  if (synced) localtime_r(&now, &tm);

  char dt[16] = "--/-- ---";
  char hm[8] = "--:--";
  if (synced) {
    strftime(dt, sizeof(dt), "%m/%d %a", &tm);
    strftime(hm, sizeof(hm), "%H:%M", &tm);
  }

  tft.loadFont(FOOTER_FONT);
  tft.setTextColor(COL_DIM, COL_BG);
  tft.setTextDatum(ML_DATUM);
  tft.drawString(dt, 6, 225);
  tft.setTextDatum(MC_DATUM);
  tft.drawString(hm, 136, 225);

  if (g_tempValid) {
    char t[12];
    snprintf(t, sizeof(t), "%.0fC", g_tempC);
    tft.setTextDatum(MR_DATUM);
    int tempW = tft.textWidth(t);
    if (g_wxCode >= 0) drawWeatherIcon(232 - tempW - 24, 214, g_wxCode);
    tft.drawString(t, 232, 225);
  }
  tft.unloadFont();
}

uint16_t barColor(int p) {
  switch (p) {
    case 0:  return tft.color565(247, 147, 26);  // 코인 orange
    case 1:  return tft.color565(40, 175, 130);  // 달러 green
    case 2:  return tft.color565(60, 130, 246);  // 주식 blue
    default: return tft.color565(60, 130, 246);  // 주식(인버스류) blue
  }
}

// HH:MM:SS, right-aligned in the header bar. Constant width -> opaque bg repaint
// is flicker-free, so it can be called every second without a full redraw.
void drawHeaderStatus() {
  tft.setTextDatum(TR_DATUM);
  tft.setTextColor(COL_DIM, COL_BG);
  tft.drawString(WiFi.localIP().toString(), 232, 9, 2);
}

// Carousel page indicator: NUM_PAGES dots centered; active one bigger + colored.
void drawPageDots() {
  const int cy = 204, spacing = 14;
  int startX = 120 - ((NUM_PAGES - 1) * spacing) / 2;
  for (int i = 0; i < NUM_PAGES; i++) {
    int cx = startX + i * spacing;
    if (i == page) tft.fillCircle(cx, cy, 3, barColor(page));
    else           tft.fillCircle(cx, cy, 1, colSep());
  }
}

// ---------------------- Pi monitor screen ----------------------
uint16_t statColor(float r) {
  if (r < 0.7f) return tft.color565(53, 199, 89);    // green
  if (r < 0.9f) return tft.color565(255, 159, 10);   // amber
  return tft.color565(255, 69, 58);                  // red
}

// line icons (~22px box at x,y), single color
void icCpu(int x, int y, uint16_t c) {
  tft.drawRoundRect(x + 4, y + 4, 14, 14, 2, c);
  tft.drawRect(x + 9, y + 9, 4, 4, c);
  for (int i = 0; i < 3; i++) {
    int o = 6 + i * 4;
    tft.drawFastVLine(x + o, y + 1, 3, c); tft.drawFastVLine(x + o, y + 18, 3, c);
    tft.drawFastHLine(x + 1, y + o, 3, c); tft.drawFastHLine(x + 18, y + o, 3, c);
  }
}
void icRam(int x, int y, uint16_t c) {
  tft.drawRoundRect(x + 1, y + 6, 20, 10, 1, c);
  for (int i = 0; i < 4; i++) tft.drawFastVLine(x + 5 + i * 4, y + 9, 4, c);
  for (int i = 0; i < 4; i++) tft.drawFastVLine(x + 4 + i * 4, y + 16, 3, c);
}
void icDisk(int x, int y, uint16_t c) {
  int cx = x + 11;
  tft.drawEllipse(cx, y + 5, 8, 3, c);
  tft.drawEllipse(cx, y + 11, 8, 3, c);
  tft.drawEllipse(cx, y + 16, 8, 3, c);
  tft.drawFastVLine(x + 3, y + 5, 11, c);
  tft.drawFastVLine(x + 19, y + 5, 11, c);
}
void icTmp(int x, int y, uint16_t c) {
  int cx = x + 11;
  tft.drawRoundRect(cx - 2, y + 2, 5, 12, 2, c);
  tft.fillCircle(cx, y + 17, 3, c);
  tft.drawFastVLine(cx, y + 6, 8, c);
}

void drawBar(int x, int y, int w, int h, float ratio, uint16_t c) {
  ratio = ratio < 0 ? 0 : (ratio > 1 ? 1 : ratio);
  tft.fillRoundRect(x, y, w, h, h / 2, colTrack());
  int fw = (int)(w * ratio);
  if (fw >= h)      tft.fillRoundRect(x, y, fw, h, h / 2, c);
  else if (fw > 0)  tft.fillRect(x, y, fw, h, c);
}

// one metric row: icon + value + bar + max (deg=true adds a degree ring)
void drawPiRow(int cy, int icon, const char* val, const char* mx, float ratio, bool deg) {
  int iy = cy - 11;
  if (icon == 0) icCpu(8, iy, colLabel());
  else if (icon == 1) icRam(8, iy, colLabel());
  else if (icon == 2) icDisk(8, iy, colLabel());
  else icTmp(8, iy, colLabel());

  tft.setTextDatum(MR_DATUM);
  tft.setTextColor(COL_TEXT, COL_BG);
  tft.drawString(val, deg ? 86 : 92, cy, 4);
  if (deg) tft.drawCircle(90, cy - 8, 2, COL_TEXT);

  drawBar(102, cy - 6, 92, 12, ratio, statColor(ratio));

  tft.setTextDatum(MR_DATUM);
  tft.setTextColor(COL_DIM, COL_BG);
  tft.drawString(mx, deg ? 230 : 234, cy, 2);
  if (deg) tft.drawCircle(233, cy - 5, 1, COL_DIM);
}

void drawPiScreen(bool fullRedraw = true) {
  tft.startWrite();
  if (fullRedraw) tft.fillScreen(COL_BG);
  else tft.fillRect(0, 0, 240, 35, COL_BG);

  float rC = g_pi.cpu / 100.0f;
  float rM = g_pi.memTotal > 0 ? g_pi.memUsed / g_pi.memTotal : 0;
  float rD = g_pi.diskTotal > 0 ? g_pi.diskUsed / g_pi.diskTotal : 0;
  float rT = g_pi.temp / 85.0f;
  bool warn = g_pi.valid && (rC >= 0.9f || rM >= 0.9f || rD >= 0.9f || rT >= 0.9f);

  const char* host = g_pi.valid ? g_pi.host : "raspi";
  tft.setTextDatum(TL_DATUM);
  tft.setTextColor(COL_TEXT, COL_BG);
  if (tft.textWidth(host, 4) <= 150) tft.drawString(host, 8, 7, 4);
  else tft.drawString(host, 8, 12, 2);

  uint16_t bbg = warn ? tft.color565(74, 47, 16) : tft.color565(18, 49, 35);
  uint16_t bfg = warn ? tft.color565(255, 207, 154) : tft.color565(74, 214, 128);
  const char* st = warn ? "WARN" : "OK";
  int bw = tft.textWidth(st, 2) + 18;
  tft.fillRoundRect(232 - bw, 8, bw, 18, 9, bbg);
  tft.setTextDatum(MC_DATUM);
  tft.setTextColor(bfg);
  tft.drawString(st, 232 - bw / 2, 17, 2);
  tft.drawFastHLine(8, 34, 224, colSep());

  if (!g_pi.valid) {
    tft.fillRect(0, 35, 240, 205, COL_BG);
    tft.setTextDatum(MC_DATUM);
    tft.setTextColor(COL_DIM, COL_BG);
    tft.drawString(cfg.piHost[0] ? "connecting..." : "set Pi address at /", 120, 112, 2);
    tft.setTextDatum(MC_DATUM);
    tft.drawString(String("TV ") + WiFi.localIP().toString(), 120, 209, 2);
    tft.drawString(String("PI ") + (cfg.piHost[0] ? cfg.piHost : "not set"), 120, 224, 2);
    tft.endWrite();
    return;
  }

  char cpu[8], ramUsed[12], ramTotal[12], diskUsed[12], diskTotal[12], temp[8], tempMax[8];
  snprintf(cpu, sizeof(cpu), "%.0f%%", g_pi.cpu);
  snprintf(ramUsed, sizeof(ramUsed), "%.1fG", g_pi.memUsed);
  snprintf(ramTotal, sizeof(ramTotal), "%.1fG", g_pi.memTotal);
  snprintf(diskUsed, sizeof(diskUsed), "%.0fG", g_pi.diskUsed);
  snprintf(diskTotal, sizeof(diskTotal), "%.0fG", g_pi.diskTotal);
  snprintf(temp, sizeof(temp), "%.0f", g_pi.temp);
  snprintf(tempMax, sizeof(tempMax), "85");
  if (!fullRedraw) { tft.fillRect(30, 42, 68, 32, COL_BG); tft.fillRect(198, 46, 42, 24, COL_BG); }
  drawPiRow(58,  0, cpu,       "100%",      rC, false);
  if (!fullRedraw) { tft.fillRect(30, 75, 68, 32, COL_BG); tft.fillRect(198, 79, 42, 24, COL_BG); }
  drawPiRow(91,  1, ramUsed,   ramTotal,     rM, false);
  if (!fullRedraw) { tft.fillRect(30, 108, 68, 32, COL_BG); tft.fillRect(198, 112, 42, 24, COL_BG); }
  drawPiRow(124, 2, diskUsed,  diskTotal,    rD, false);
  if (!fullRedraw) { tft.fillRect(30, 141, 68, 32, COL_BG); tft.fillRect(198, 145, 42, 24, COL_BG); }
  drawPiRow(157, 3, temp,      tempMax,      rT, true);
  if (fullRedraw) {
    tft.setTextDatum(MC_DATUM);
    tft.setTextColor(COL_DIM, COL_BG);
    tft.drawString(String("TV ") + WiFi.localIP().toString(), 120, 209, 2);
    tft.drawString(String("PI ") + cfg.piHost, 120, 224, 2);
  }
  tft.endWrite();
}

void drawPage(bool fullRedraw = true, bool pageTransition = false) {
  Ticker* items = pageItems[page];
  uint16_t acc = barColor(page);
  const int rowY[ROWS_PER_PAGE] = {45, 96, 147};

  tft.startWrite();
  if (fullRedraw) {
    tft.fillScreen(COL_BG);
    drawKRLabel(8, 6, *pageTitle[page], COL_TEXT);
    drawHeaderStatus();
    tft.fillRect(8, 32, 224, 2, acc);
  } else if (pageTransition) {
    // Replace the header in place instead of blanking the whole display.
    tft.fillRect(0, 0, 160, 32, COL_BG);
    drawKRLabel(8, 6, *pageTitle[page], COL_TEXT);
    drawHeaderStatus();   // right-aligned IP overhangs the cleared area; repaint it
    tft.fillRect(8, 32, 224, 2, acc);
  } else {
    // Data refresh: preserve the static header and clear only dynamic content.
    tft.fillRect(0, 35, 240, 175, COL_BG);
  }

  for (int i = 0; i < ROWS_PER_PAGE; i++) {
    if (pageTransition) {
      int top = (i == 0) ? 35 : rowY[i] - 8;
      int bottom = (i == ROWS_PER_PAGE - 1) ? 190 : rowY[i] + 42;
      tft.fillRect(0, top, 240, bottom - top, COL_BG);
    }
    drawRow(rowY[i], items[i]);
  }

  tft.drawFastHLine(8, 87, 224, colSep());
  tft.drawFastHLine(8, 138, 224, colSep());
  if (pageTransition) tft.fillRect(0, 190, 240, 20, COL_BG);
  drawPageDots();
  if (!pageTransition) drawFooter();
  tft.endWrite();
}

void applyBrightness(uint8_t b) {  // active-low: higher duty = dimmer
  analogWrite(TFT_BL, 255 - b);
  appliedBright = b;
}

bool isNightNow() {
  time_t now = time(nullptr);
  if (now <= 100000) return false;  // clock not synced
  struct tm tm;
  localtime_r(&now, &tm);
  int h = tm.tm_hour;
  if (cfg.nightStart == cfg.nightEnd) return false;
  if (cfg.nightStart < cfg.nightEnd) return h >= cfg.nightStart && h < cfg.nightEnd;
  return h >= cfg.nightStart || h < cfg.nightEnd;  // window wraps past midnight
}

// Seconds progress ring around the edge (updated once per second).
void drawSecondsRing(int sec) {
  const int cx = 120, cy = 112, r = 100, ir = 97;
  uint16_t track = tft.color565(30, 34, 44);
  uint16_t acc   = tft.color565(90, 150, 255);
  tft.drawArc(cx, cy, r, ir, 0, 360, track, COL_BG, false);
  if (sec == 0) return;
  // TFT_eSPI: 0deg = 6 o'clock, increasing clockwise -> 180deg = 12 o'clock.
  int e = 180 + (sec * 360) / 60;
  if (e <= 360) tft.drawArc(cx, cy, r, ir, 180, e, acc, COL_BG, false);
  else { tft.drawArc(cx, cy, r, ir, 180, 360, acc, COL_BG, false);
         tft.drawArc(cx, cy, r, ir, 0, e - 360, acc, COL_BG, false); }
}

// Night mode: big anti-aliased clock + date/weekday + weather, with a seconds ring.
void drawClockScreen() {
  tft.fillScreen(COL_BG);
  time_t now = time(nullptr);
  struct tm tm;
  localtime_r(&now, &tm);

  char hm[6];
  strftime(hm, sizeof(hm), "%H:%M", &tm);
  tft.loadFont(CLOCK_FONT);
  tft.setTextDatum(MC_DATUM);
  tft.setTextColor(COL_TEXT, COL_BG);
  tft.drawString(hm, 120, 92);
  tft.unloadFont();

  char d[24];
  strftime(d, sizeof(d), "%m/%d  %a", &tm);
  tft.setTextDatum(MC_DATUM);
  tft.setTextColor(COL_DIM, COL_BG);
  tft.drawString(d, 120, 148, 2);

  if (g_tempValid) {
    char t[12];
    snprintf(t, sizeof(t), "%.0fC", g_tempC);
    int tw = tft.textWidth(t, 2);
    int block = (g_wxCode >= 0 ? 24 : 0) + tw;
    int x = 120 - block / 2;
    if (g_wxCode >= 0) { drawWeatherIcon(x, 169, g_wxCode); x += 24; }
    tft.setTextDatum(TL_DATUM);
    tft.setTextColor(COL_DIM, COL_BG);
    tft.drawString(t, x, 176, 2);
  }

  drawSecondsRing(tm.tm_sec);
}

// -------------------------------- setup --------------------------------
// Boot splash: "Glance" title + rising-chart motif + a status line.
void drawSplash(const char* status) {
  tft.fillScreen(COL_BG);
  uint16_t acc = tft.color565(247, 147, 26);
  const int mx[6] = {68, 90, 112, 134, 156, 176};
  const int my[6] = {84, 74, 78, 62, 68, 48};
  for (int i = 1; i < 6; i++)
    tft.drawWideLine(mx[i-1], my[i-1], mx[i], my[i], 3, acc, COL_BG);
  tft.drawWideLine(176, 48, 167, 48, 3, acc, COL_BG);   // arrow head
  tft.drawWideLine(176, 48, 176, 58, 3, acc, COL_BG);

  drawLogo(120 - TITLE_GLANCE.w / 2, 108, &TITLE_GLANCE);

  tft.setTextDatum(MC_DATUM);
  tft.setTextColor(COL_DIM, COL_BG);
  tft.drawString("ticker + pi monitor", 120, 160, 2);
  if (status && *status) tft.drawString(status, 120, 210, 2);
}

// Splash variant shown when WiFiManager opens the setup hotspot.
void drawSplashSetup() {
  tft.fillScreen(COL_BG);
  uint16_t acc = tft.color565(247, 147, 26);
  drawLogo(120 - TITLE_GLANCE.w / 2, 74, &TITLE_GLANCE);
  tft.setTextDatum(MC_DATUM);
  tft.setTextColor(COL_DIM, COL_BG);
  tft.drawString("Join this hotspot", 120, 138, 2);
  int w = tft.textWidth(AP_NAME, 2) + 22;
  int px = 120 - w / 2, py = 158;
  tft.drawRoundRect(px, py, w, 26, 9, acc);
  tft.setTextColor(acc, COL_BG);
  tft.drawString(AP_NAME, 120, py + 13, 2);
}

void apCallback(WiFiManager* /*m*/) { drawSplashSetup(); }

// Blocking on first boot only: connects with saved creds, or opens the
// AP_NAME setup portal until configured or PORTAL_TIMEOUT_S elapses.
void connectWiFi() {
  drawSplash("connecting WiFi...");
  WiFi.mode(WIFI_STA);
  WiFiManager wm;
  wm.setAPCallback(apCallback);
  wm.setConfigPortalTimeout(PORTAL_TIMEOUT_S);
  if (wm.autoConnect(AP_NAME)) {
    Serial.println(WiFi.localIP().toString());
  } else {
    Serial.println("WiFi portal timed out; will retry in loop.");
  }
}

static String chk(bool b) { return b ? " checked" : ""; }

// Settings page.
void handleRoot() {
  String h =
    "<!doctype html><meta name=viewport content='width=device-width,initial-scale=1'>"
    "<style>body{font-family:sans-serif;margin:1.2em;max-width:430px}"
    "label{display:block;margin:.7em 0 .15em;font-size:.9em}"
    "input,select{width:100%;padding:.45em;box-sizing:border-box}"
    ".row{display:flex;gap:10px}.row>div{flex:1}"
    "button{margin-top:1.2em;padding:.7em 1.4em;font-size:1em}</style>"
    "<h2>Glance</h2><form method=POST action=/save>"
    "<label>Mode</label><select name=md>"
    "<option value=0" + String(cfg.mode == 0 ? " selected" : "") + ">Market ticker</option>"
    "<option value=1" + String(cfg.mode == 1 ? " selected" : "") + ">Pi monitor</option>"
    "<option value=2" + String(cfg.mode == 2 ? " selected" : "") + ">Clock</option>"
    "</select>"
    "<div class=row><div><label>Pi host / IP</label>"
    "<input name=ph value='" + String(cfg.piHost) + "'></div>"
    "<div><label>Pi port</label>"
    "<input type=number name=pp min=1 max=65535 value=" + String(cfg.piPort) + "></div></div>"
    "<hr style='margin:1.2em 0;border:none;border-top:1px solid #ccc'>"
    "<label>Day brightness (0-255)</label>"
    "<input type=number name=br min=0 max=255 value=" + String(cfg.brightness) + ">"
    "<div class=row><div><label>Night start (hour)</label>"
    "<input type=number name=ns min=0 max=23 value=" + String(cfg.nightStart) + "></div>"
    "<div><label>Night end (hour)</label>"
    "<input type=number name=nd min=0 max=23 value=" + String(cfg.nightEnd) + "></div></div>"
    "<label><input type=checkbox name=dm" + chk(cfg.nightDim) + "> Dim screen at night</label>"
    "<label>Night brightness (0-255)</label>"
    "<input type=number name=nb min=0 max=255 value=" + String(cfg.nightBright) + ">"
    "<label><input type=checkbox name=nc" + chk(cfg.nightClock) + "> Big clock at night</label>"
    "<div class=row><div><label>Page swap (s)</label>"
    "<input type=number name=ps min=2 max=60 value=" + String(cfg.pageSec) + "></div>"
    "<div><label>Refresh (s)</label>"
    "<input type=number name=fs min=15 max=600 value=" + String(cfg.fetchSec) + "></div></div>"
    "<button type=submit>Save</button></form>"
    "<form method=POST action=/wifi style='margin-top:1.5em' "
    "onsubmit=\"return confirm('Reset WiFi and reboot into setup mode?')\">"
    "<button type=submit>Reset WiFi</button></form>"
    "<p style='margin-top:1.2em'><a href='/update'>Firmware update</a> &middot; IP " +
    WiFi.localIP().toString() + "</p>";
  httpServer.send(200, "text/html", h);
}

void handleSave() {
  uint8_t previousMode = cfg.mode;
  if (httpServer.hasArg("br")) cfg.brightness  = constrain(httpServer.arg("br").toInt(), 0, 255);
  if (httpServer.hasArg("nb")) cfg.nightBright = constrain(httpServer.arg("nb").toInt(), 0, 255);
  if (httpServer.hasArg("ns")) cfg.nightStart  = constrain(httpServer.arg("ns").toInt(), 0, 23);
  if (httpServer.hasArg("nd")) cfg.nightEnd    = constrain(httpServer.arg("nd").toInt(), 0, 23);
  if (httpServer.hasArg("ps")) cfg.pageSec     = constrain(httpServer.arg("ps").toInt(), 2, 60);
  if (httpServer.hasArg("fs")) cfg.fetchSec    = constrain(httpServer.arg("fs").toInt(), 15, 600);
  if (httpServer.hasArg("md")) cfg.mode        = constrain(httpServer.arg("md").toInt(), 0, NUM_MODES - 1);
  if (httpServer.hasArg("pp")) cfg.piPort      = constrain(httpServer.arg("pp").toInt(), 1, 65535);
  if (httpServer.hasArg("ph")) strlcpy(cfg.piHost, httpServer.arg("ph").c_str(), sizeof(cfg.piHost));
  cfg.nightDim   = httpServer.hasArg("dm");    // checkboxes only post when ticked
  cfg.nightClock = httpServer.hasArg("nc");
  forceFullRedraw = previousMode != cfg.mode;
  if (previousMode != cfg.mode) autoClock = false;  // explicit mode change overrides auto-clock
  cfgSave();
  applyBrightness(isNightNow() ? cfg.nightBright : cfg.brightness);
  clockMode = false; lastClockMin = -1; lastPage = 0;
  lastFetch = 0;  // refetch in the (possibly new) mode right away
  httpServer.sendHeader("Location", "/");
  httpServer.send(303, "text/plain", "saved");
}

// Forget the saved WiFi and reboot into the SmallTV-Setup portal.
void handleWifiReset() {
  httpServer.send(200, "text/html",
    "<meta name=viewport content='width=device-width,initial-scale=1'>"
    "<body style='font-family:sans-serif;margin:2em'><h3>WiFi reset</h3>"
    "<p>Rebooting into setup mode. Connect your phone to the "
    "<b>SmallTV-Setup</b> WiFi network to pick a new network.</p></body>");
  delay(400);  // let the response flush before we drop the connection
  WiFiManager wm;
  wm.resetSettings();
  ESP.restart();
}

// Web UI: settings at "/", save at "/save", OTA firmware upload at "/update".
void startWebServer() {
  httpUpdater.setup(&httpServer, "/update", OTA_USER, OTA_PASS);
  httpServer.on("/", handleRoot);
  httpServer.on("/save", HTTP_POST, handleSave);
  httpServer.on("/wifi", HTTP_POST, handleWifiReset);
  httpServer.begin();
  Serial.println("Web server up: http://" + WiFi.localIP().toString() + "/");
}

void fetchCurrent() {
  if (cfg.mode == 0)      fetchAll();
  else if (cfg.mode == 1) fetchPiStats();
  else                    fetchWeather();   // clock mode only needs weather
}
void renderCurrent() {
  if (cfg.mode == 0)      drawPage();
  else if (cfg.mode == 1) drawPiScreen();
  else                    drawClockScreen();
}

// Async fetch (Pro/ESP32 only): the network I/O is blocking (~10-20s for the
// full market pull), which would freeze touch + the clock. ESP32 is dual-core,
// so we run fetches in a task pinned to core 0 while the UI stays live on core
// 1. The task only writes the ticker/weather structs; the main loop reads them
// to render -- a torn value is at worst one cosmetically-off frame, so no lock
// is needed. On the single-core Ultra this whole block is compiled out and the
// fetch stays inline (see loop()).
#if defined(ESP32)
volatile bool g_fetchReq  = false;   // main -> task: please fetch now
volatile bool g_fetchDone = false;   // task -> main: fresh data is ready to draw
volatile bool g_fetching  = false;   // task is mid-fetch

void fetchTask(void*) {
  for (;;) {
    if (g_fetchReq) {
      g_fetchReq = false;
      g_fetching = true;
      fetchCurrent();
      g_fetching = false;
      g_fetchDone = true;
    }
    vTaskDelay(pdMS_TO_TICKS(20));
  }
}
#endif

// ---------------- mode-select menu + touch button (Pro only) ----------------
// The menu screen and mode switching are plain logic; only the *input* that
// drives them (the capacitive pad) is ESP32-specific, so it's guarded below.
void drawModeMenu() {
  tft.fillScreen(COL_BG);
  drawLogo(120 - TITLE_GLANCE.w / 2, 20, &TITLE_GLANCE);
  tft.setTextDatum(MC_DATUM);
  tft.setTextColor(COL_DIM, COL_BG);
  tft.drawString("select mode", 120, 66, 2);

  const int y0 = 100, dy = 38;
  for (int i = 0; i < NUM_MODES; i++) {
    int y = y0 + i * dy;
    bool sel = (i == menuSel);
    if (sel) tft.drawRoundRect(28, y - 16, 184, 32, 8, barColor(0));
    tft.setTextDatum(MC_DATUM);
    tft.setTextColor(sel ? COL_TEXT : COL_DIM, COL_BG);
    tft.drawString(MODE_NAMES[i], 120, y, 4);
  }
  tft.setTextDatum(MC_DATUM);
  tft.setTextColor(tft.color565(170, 180, 200), COL_BG);   // legible grey (COL_DIM was too dark here)
  tft.drawString("tap : next   double : ok   hold : back", 120, 224, 2);
}

// Switch into a mode and force a clean redraw + refetch on the next loop.
void applyMode(uint8_t m) {
  cfg.mode = m % NUM_MODES;
  autoClock = false;           // an explicit choice overrides tonight's auto-clock
  forceFullRedraw = true;
  clockMode = false; lastClockMin = -1; lastSec = -1;
  lastPage = millis();
  lastFetch = 0;               // (re)fetch for the new mode right away
  renderCurrent();             // show the frame NOW; async fetch fills the data in
}

#if defined(ESP32)
enum TouchGesture { G_NONE, G_TAP, G_DOUBLE, G_LONG };

void calibrateTouch() {
  long acc = 0;
  for (int i = 0; i < 16; i++) { acc += touchRead(TOUCH_GPIO); delay(6); }
  touchBaseline = acc / 16;
  Serial.printf("touch baseline (GPIO%d) = %d\n", TOUCH_GPIO, touchBaseline);
}

// One-pad gesture recognizer. Returns at most one gesture per call. A single
// tap is reported only after the double-tap window lapses, so it can be told
// apart from a double tap; a long press fires while still held and suppresses
// the tap that would otherwise land on release.
// detectDouble=false (normal view): a tap fires immediately on release -- there's
// no double-tap action there, so waiting for one only adds lag and lets the 6s
// auto-page timer race in for a phantom second advance. =true (menu): defer to
// tell a single tap from a double.
TouchGesture pollTouch(bool detectDouble) {
  static bool     pressed = false;
  static uint32_t pressStart = 0;
  static bool     longFired = false;
  static bool     pendingTap = false;
  static uint32_t lastTapMs = 0;

  uint32_t now = millis();
  int v = touchRead(TOUCH_GPIO);
  // Schmitt trigger: engage at TOUCH_TRIG, release only after recovering to
  // TOUCH_REL, so a single wobbly touch can't chatter into multiple taps.
  float drop = touchBaseline > 0 ? (float)(touchBaseline - v) / touchBaseline : 0;
  bool down = pressed ? (drop > TOUCH_REL) : (drop > TOUCH_TRIG);
  TouchGesture g = G_NONE;

  if (down && !pressed) {                 // press edge
    pressed = true; pressStart = now; longFired = false;
  } else if (down && pressed) {           // held
    if (!longFired && now - pressStart >= LONGPRESS_MS) {
      longFired = true; pendingTap = false; g = G_LONG;
    }
  } else if (!down && pressed) {          // release edge
    pressed = false;
    if (!longFired) {                     // released before the long-press point => a tap
      if (!detectDouble)                              g = G_TAP;         // view: fire now
      else if (pendingTap && now - lastTapMs <= DOUBLETAP_MS) { pendingTap = false; g = G_DOUBLE; }
      else                                            { pendingTap = true; lastTapMs = now; }
    }
  }
  // menu only: a lone tap resolves once no second tap arrived in the window
  if (detectDouble && g == G_NONE && pendingTap && now - lastTapMs > DOUBLETAP_MS) {
    pendingTap = false; g = G_TAP;
  }
  return g;
}

void openModeMenu() {
  inMenu = true;
  menuSel = (cfg.mode < NUM_MODES) ? cfg.mode : 0;
  menuOpenedMs = millis();
  drawModeMenu();
}
void closeModeMenu() {                    // leave the menu without changing mode
  inMenu = false;
  applyMode(cfg.mode);                    // redraw the current mode cleanly
}

// Map a gesture to an action, in whichever context we're in.
void applyGesture(TouchGesture g) {
  if (g == G_NONE) return;
  if (!inMenu) {
    if (g == G_TAP) {                     // next page (market mode, and not while the clock is up)
      if (cfg.mode == 0 && !clockMode) { page = (page + 1) % NUM_PAGES; drawPage(false, true); lastPage = millis(); }
    } else if (g == G_LONG) {             // open the mode menu
      openModeMenu();
    }
    // G_DOUBLE: reserved / unused in normal view
  } else {
    menuOpenedMs = millis();              // any gesture resets the inactivity timer
    if (g == G_TAP)         { menuSel = (menuSel + 1) % NUM_MODES; drawModeMenu(); }
    else if (g == G_DOUBLE) { applyMode(menuSel); inMenu = false; }
    else if (g == G_LONG)   { closeModeMenu(); }
  }
}
#endif  // ESP32

void setup() {
  Serial.begin(115200);
  cfgLoad();
  tft.init();
  tft.setRotation(ROTATION);
  tft.invertDisplay(INVERT_COLORS);
  tft.fillScreen(COL_BG);

  // Backlight is ACTIVE-LOW: PWM duty is inverted, so higher duty = dimmer.
  pinMode(TFT_BL, OUTPUT);
#if !defined(ESP32)
  analogWriteRange(255);          // ESP32's analogWrite is 8-bit already
#endif
  applyBrightness(cfg.brightness);

  connectWiFi();
  startWebServer();
#if defined(ESP32)
  calibrateTouch();               // Pro: sample the idle touch level before use
#endif
  configTime(TZ_OFFSET_SEC, 0, "pool.ntp.org", "time.nist.gov");  // NTP for clock
  drawSplash("loading data...");   // the first fetch can take ~20 s
  fetchCurrent();
  lastFetch = millis();
  g_displayStartMs = millis();  // start the IP-visible window from here, not from boot
  renderCurrent();
  lastPage = millis();

#if defined(ESP32)
  // Hand all further fetches to core 0 so the UI (core 1) never blocks on I/O.
  // 16KB stack covers the TLS/JSON work; priority 1 keeps it below the UI.
  xTaskCreatePinnedToCore(fetchTask, "fetch", 16384, nullptr, 1, nullptr, 0);
#endif
}

void loop() {
  uint32_t now = millis();

  httpServer.handleClient();  // serve status page + OTA uploads

  // Non-blocking reconnect if WiFi drops (uses saved creds, no portal here).
  if (WiFi.status() != WL_CONNECTED) {
    WiFi.reconnect();
    delay(500);
    return;
  }

  // Touch button (Pro): drive page/mode navigation. On the Ultra there's no
  // pad, so inMenu never becomes true and this whole section is compiled out.
#if defined(ESP32)
  applyGesture(pollTouch(inMenu));   // view: tap fires immediately; menu: wait to detect double
  // Fresh millis() here: menuOpenedMs is set *during* applyGesture (after `now`
  // was captured at the top of loop), so `now - menuOpenedMs` would underflow
  // and fire the timeout the instant the menu opens.
  if (inMenu && millis() - menuOpenedMs > MENU_TIMEOUT_MS) closeModeMenu();
#endif
  if (inMenu) { delay(20); return; }   // menu is showing: pause fetch/render

  // Refresh `now`: a tap handled above set lastPage=millis() (later than the
  // `now` captured at the top of loop), so the page/fetch timers below would see
  // `now - lastPage` underflow and fire a phantom second page advance.
  now = millis();

  // Keep fetching in the background. Pi monitor uses its own fast interval
  // (local agent, no rate limit); market uses the configurable Refresh (s).
  uint32_t fetchInterval = (cfg.mode == 1) ? PIMON_INTERVAL_MS
                                           : (uint32_t)cfg.fetchSec * 1000UL;
#if defined(ESP32)
  // Kick the background fetch on interval; draw only once it reports fresh data.
  if (now - lastFetch >= fetchInterval && !g_fetching) { lastFetch = now; g_fetchReq = true; }
  if (g_fetchDone) {
    g_fetchDone = false;
    if (!clockMode) {
      if (cfg.mode == 0) drawPage(forceFullRedraw);
      else if (cfg.mode == 1) drawPiScreen(forceFullRedraw);
      forceFullRedraw = false;
    }
  }
#else
  if (now - lastFetch >= fetchInterval) {   // Ultra: single core, blocking fetch
    fetchCurrent();
    lastFetch = now;
    if (!clockMode) {
      if (cfg.mode == 0) drawPage(forceFullRedraw);
      else drawPiScreen(forceFullRedraw);
      forceFullRedraw = false;
    }
  }
#endif

  // Night window: dim and/or big clock, each independent.
  bool night = isNightNow();
  uint8_t targetB = (night && cfg.nightDim) ? cfg.nightBright : cfg.brightness;
  if (targetB != appliedBright) applyBrightness(targetB);

  // Night auto-clock: when the night window opens, default to the clock. But if
  // the user then picks a mode (menu/web -> applyMode/handleSave clear autoClock),
  // stay in that mode for the rest of this night. Each new night re-arms it.
  if (night && !prevNight && cfg.nightClock) autoClock = true;   // night just began
  if (!night) autoClock = false;                                 // daytime: never auto-clock
  prevNight = night;

  bool wantClock = (cfg.mode == 2) || autoClock;
  if (wantClock != clockMode) {           // mode just changed
    clockMode = wantClock;
    lastClockMin = -1;
    if (clockMode) drawClockScreen();
    else { renderCurrent(); lastPage = now; }
  }

  time_t t = time(nullptr);
  struct tm tm;
  bool haveTime = t > 100000;
  if (haveTime) localtime_r(&t, &tm);

  if (clockMode) {
    // full redraw on minute change; just the seconds ring the rest of the time
    if (haveTime && tm.tm_min != lastClockMin) {
      drawClockScreen(); lastClockMin = tm.tm_min; lastSec = tm.tm_sec;
    } else if (haveTime && tm.tm_sec != lastSec) {
      drawSecondsRing(tm.tm_sec); lastSec = tm.tm_sec;
    }
  } else if (cfg.mode == 0) {
    // market: page cycling + live header clock
    if (now - lastPage >= (uint32_t)cfg.pageSec * 1000UL) {
      page = (page + 1) % NUM_PAGES;
      drawPage(false, true);
      lastPage = now;
    }
    if (haveTime && tm.tm_min != lastSec) { drawFooter(); lastSec = tm.tm_min; }
  }
  // Pi monitor (mode 1): static screen, redrawn on the fetch tick only.

  delay(50);
}
